## init/Kconfig.rej
```kconfig
--- init/Kconfig	2010-11-20 21:28:31.879000072 -0500
+++ init/Kconfig	2010-11-20 21:32:52.046000072 -0500
@@ -648,6 +648,18 @@
 
 endif # CGROUPS
 
+config SCHED_AUTOGROUP
+	bool "Automatic process group scheduling"
+	select CGROUPS
+	select CGROUP_SCHED
+	select FAIR_GROUP_SCHED
+	help
+	  This option optimizes the scheduler for common desktop workloads by
+	  automatically creating and populating task groups.  This separation
+	  of workloads isolates aggressive CPU burners (like build jobs) from
+	  desktop applications.  Task group autogeneration is currently based
+	  upon task session.
+
 config MM_OWNER
 	bool
 
```
